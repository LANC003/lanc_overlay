## conf/machine/lanc.conf
```bitbake
#@TYPE: Machine
#@Name: LANC board based on Atmel AT91SAM9G45
#@DESCRIPTION: Machine configuration for lanc board with a at91sam9g45 processor

TARGET_ARCH = "arm"
SOC_FAMILY = "at91"

PREFERRED_PROVIDER_virtual/kernel = "linux-lanc"
PREFERRED_VERSION_linux-lanc = "2.6.37"
KERNEL_IMAGETYPE = "uImage"
UBOOT_ENTRYPOINT = "0x70008000"
UBOOT_LOADADDRESS = "0x70008000"

PREFERRED_PROVIDER_at91bootstrap = "at91bootstrap"
PREFERRED_VERSION_at91bootstrap = "2.13"
AT91BOOTSTRAP_BOARD = "at91sam9g45nf"

PREFERRED_PROVIDER_u-boot = "u-boot_2009.11"
PREFERRED_VERSION_u-boot = "2009.11"
UBOOT_MACHINE = "at91sam9m10g45ek_nandflash_config"

#don't try to access tty1
USE_VT = "0"

MACHINE_FEATURES = " kernel26 ext2 vfat "
EXTRA_IMAGEDEPENDS += "at91bootstrap"
EXTRA_IMAGEDEPENDS += "u-boot"

# used by sysvinit_2
SERIAL_CONSOLE = "115200 ttyS0"
IMAGE_FSTYPES ?= "jffs2"
EXTRA_IMAGECMD_jffs2 = "--pad --little-endian --eraseblock=0x20000 -n"

require conf/machine/include/tune-arm926ejs.inc
```
